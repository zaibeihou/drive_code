/dts-v1/;


/ {
	model = "this is my_device_tree";

	ft5x06@38{
		compatible = "edt,edt-ft5206";
		interrupt-parent = <&gpio3>;
		interrupts = <101 1>;
	};

	led:led@1{
		compatible = "my_led";
		gpios=<&gpio0 RK_PB7 GPIO_ACTIVE_HIGH>;
	};
};
